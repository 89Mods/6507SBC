.feature string_escapes
.feature org_per_seg
.feature c_comments

PORT1_OUT = $0201
PORT2_OUT = $0202
PORT_IN   = $0208

mem_start = $80
port1_shadow = mem_start
port2_shadow = mem_start+1
temp = mem_start+2
ptr_lo = mem_start+3
ptr_hi = mem_start+4
temp2 = mem_start+5

.segment "CODE"
NMI:
	rti
IRQ:
	rti
RESET:
	ldx #$FF
	txs
	lda #0
	sta port2_shadow
	sta temp
	
	lda #(vgm_data&255)
	sta ptr_lo
	lda #((vgm_data/256)&255)
	sta ptr_hi
	
	lda #64
	sta PORT1_OUT
	sta port1_shadow
	
	jsr init_psg
	
loop:
	lda port2_shadow
	eor #1
	sta PORT2_OUT
	sta port2_shadow
	ldx #0
	lda (ptr_lo,X)
	cmp #$50
	beq vgm_note
	cmp #$61
	beq vgm_delay
	cmp #$63
	beq vgm_20ms
	cmp #$66
	beq end_song
	jmp end_switch
vgm_note:
	jsr inc_pointer
	lda (ptr_lo,X)
	jsr psg_write
	jmp end_switch
vgm_delay:
	jsr inc_pointer
	lda (ptr_lo,X)
	sta temp
	jsr inc_pointer
	lda (ptr_lo,X)
	sta temp2
	
	lda temp2
	lsr
	sta temp2
	lda temp
	ror
	sta temp
vgm_delay_loop:
	nop
	nop
	nop
	nop
	nop
	nop
	nop
	nop
	nop
	lda temp
	sec
	sbc #1
	sta temp
	lda temp2
	sbc #0
	sta temp2
	lda #0
	ora temp
	ora temp2
	bne vgm_delay_loop
	jmp end_switch
vgm_20ms:
	lda #$72
	sta temp
	lda #$03
	sta temp2
	jmp vgm_delay_loop
end_switch:

	jsr inc_pointer
	jmp loop
	
end_song:
	lda #%11111001
	jsr psg_write
	lda #%11111011
	jsr psg_write
	lda #%11111101
	jsr psg_write
	lda #%11111111
	jsr psg_write
halt:
	nop
	lda #%11111001
	jsr psg_write
	lda port2_shadow
	eor #1
	sta PORT2_OUT
	sta port2_shadow
	lda #31
	jsr long_delay
	lda PORT_IN
	and #1
	bne halt
	jmp RESET
	
inc_pointer:
	lda ptr_lo
	clc
	adc #1
	sta ptr_lo
	lda ptr_hi
	adc #0
	sta ptr_hi
	rts

init_psg:
	lda #%11111001
	jsr psg_write
	lda #%11111011
	jsr psg_write
	lda #%11111101
	jsr psg_write
	lda #%11111111
	jsr psg_write
	
	lda #64
	jsr long_delay
	
	lda #%00110001
	jsr psg_write
	lda #%00100000
	jsr psg_write
	
	lda #%00011001
	jsr psg_write
	lda #16
	jsr long_delay
	lda #%11111001
	jsr psg_write
	lda #4
	jsr long_delay
	lda #%00011001
	jsr psg_write
	lda #16
	jsr long_delay
	lda #%11111001
	jsr psg_write
	
	lda #64
	jsr long_delay
	rts

psg_write:
	pha
	lda port1_shadow
	and #%11110000
	sta port1_shadow
	pla
	pha
	and #%00001111
	ora port1_shadow
	sta PORT1_OUT
	sta port1_shadow
	
	lda port2_shadow
	and #%00001111
	sta port2_shadow
	pla
	and #%11110000
	ora port2_shadow
	sta PORT2_OUT
	sta port2_shadow
	
	lda port1_shadow
	and #%10111111
	sta PORT1_OUT
	nop
	nop
	nop
	nop
	nop
	nop
	ora #%01000000
	sta PORT1_OUT
	sta port1_shadow
	nop
	nop
	nop
	nop
	rts

long_delay:
	jsr delay
	sec
	sbc #1
	bcs long_delay
	rts

delay:
	pha
	lda #0
delay_loop:
	nop
	nop
	nop
	nop
	nop
	nop
	nop
	nop
	nop
	nop
	nop
	nop
	nop
	nop
	nop
	nop
	nop
	nop
	nop
	nop
	nop
	nop
	nop
	clc
	adc #1
	bcc delay_loop
	pla
	rts

vgm_data:
.byte $50, $fd, $61, $17, $00, $50, $cb, $61
.byte $0d, $00, $50, $03, $61, $02, $00, $50
.byte $70, $61, $90, $01, $50, $f9, $61, $0c
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.byte $f9, $66

.byte 'E','O','F'

.segment "VECTORS"
.word NMI,RESET,IRQ
